// Copyright 2022 Manna Harbour
// https://github.com/manna-harbour/miryoku

#include "../miryoku/custom_config.h"
#include "../miryoku/mapping/38/totem.h"
#include "../miryoku/miryoku.dtsi"

#define HOST_OS 1  // set to 1 for Linux, default is 0 (Windows)
#include "../zmk-nodefree-config/helper.h"
#include "../zmk-nodefree-config/keypos_def/keypos_38keys.h"
#include "../zmk-nodefree-config/international_chars/swedish.dtsi"

#undef COMBO_TERM
#define COMBO_TERM 30  // timeout of 40ms (default is 30ms if omitted)
ZMK_COMBO(combo_copy,   &kp LC(C),  LB2 LM2, ALL)  // Ctrl + C, active on all layers
ZMK_COMBO(combo_paste,  &kp LC(LS(V)),  LB1 LM1, ALL)  // Ctrl + V, active on all layers
ZMK_COMBO(combo_ao,  &sv_ao,  RT2 RM2, ALL)
ZMK_COMBO(combo_ae,  &sv_ae,  RT3 RM3, ALL)
ZMK_COMBO(combo_oe,  &sv_oe,  RT4 RM4, ALL)
ZMK_COMBO(combo_up,  &kp UP,  RT0 RM0, ALL)
ZMK_COMBO(combo_down,  &kp DOWN,  RM0 RB0, ALL)
ZMK_COMBO(combo_dash,  &kp MINUS,  RM1 RB1, ALL)
